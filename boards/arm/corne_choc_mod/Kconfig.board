## boards/arm/corne_choc_mod/Kconfig.board
```kconfig
# Copyright (c) 2020 The ZMK Contributors
# SPDX-License-Identifier: MIT

config BOARD_CORNE_CHOC_MOD_LEFT
	bool "Corne Choc Mod Left"
	depends on SOC_NRF52840_QIAA

config BOARD_CORNE_CHOC_MOD_RIGHT
    bool "Corne Choc Mod Right"
    depends on SOC_NRF52840_QIAA
```

## boards/arm/corne_choc_single_right/Kconfig.board
```kconfig
# Copyright (c) 2020 The ZMK Contributors
# SPDX-License-Identifier: MIT

config BOARD_CORNE_CHOC_SINGLE_RIGHT_BOARD
	bool "Corne Choc Single Right"
	depends on SOC_NRF52840_QIAA
```

## boards/arm/corne_choc_single_right/Kconfig.defconfig
```kconfig
# Copyright (c) 2020 The ZMK Contributors
# SPDX-License-Identifier: MIT

if BOARD_CORNE_CHOC_SINGLE_RIGHT_BOARD

config ZMK_KEYBOARD_NAME
	default "Corne Choc RH"

config ZMK_SPLIT_ROLE_CENTRAL
    default y

endif # BOARD_CORNE_CHOC_SINGLE_RIGHT_BOARD

if BOARD_CORNE_CHOC_SINGLE_RIGHT_BOARD

config BOARD
    default "corne_choc_single_right"

config ZMK_SPLIT
    default y

if USB

config USB_NRFX
	default y

config USB_DEVICE_STACK
	default y

endif # USB

config BT_CTLR
	default BT

config I2C
	default y

config ZMK_MAX17048
    default y

endif # BOARD_CORNE_CHOC_SINGLE_RIGHT_BOARD
```

## config/west.yml
```yaml
manifest:
  remotes:
    - name: zmkfirmware
      url_base: https://github.com/zmkfirmware
  projects:
    - name: zmk
      remote: zmkfirmware
      revision: v0.3
      import: app/west.yml
  self:
    path: config
```
